## contrib/board/gridpoint/ec100/ec100nf_uboot_defconfig
```kconfig
CONFIG_EC100=y
CONFIG_NANDFLASH=y
CONFIG_DEBUG=y
CONFIG_THUMB=n
CONFIG_ON_DIE_ECC=y
CONFIG_ENABLE_SW_ECC=n
CONFIG_IMG_ADDRESS="0x00020000"
CONFIG_IMG_SIZE="0x00080000"
CONFIG_JUMP_ADDR="0x23f00000"
CONFIG_BUS_SPEED_100MHZ=y
```

## contrib/board/gridpoint/ec2000/ec2000df_uboot_defconfig
```kconfig
CONFIG_EC2000=y
CONFIG_DDRC=y
CONFIG_RAM_128MB=y
CONFIG_DDR2=y
CONFIG_DATAFLASH=y
CONFIG_QSPI=y
CONFIG_QSPI_BUS1=y
CONFIG_QSPI1_IOSET_2=y
CONFIG_LOAD_UBOOT=y
CONFIG_IMG_ADDRESS="0x00008000"
CONFIG_JUMP_ADDR="0x23f00000"
CONFIG_IMG_SIZE="0x000a0000"
CONFIG_DEBUG=y
CONFIG_DEBUG_INFO=y
```
